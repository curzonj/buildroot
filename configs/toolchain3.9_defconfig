## configs/toolchain3.9_defconfig
```kconfig
BR2_x86_i686=y
BR2_DEFCONFIG="$(CONFIG_DIR)/defconfig"
BR2_HOST_DIR="/usr/local/uclibc-toolchain-3.9"
BR2_KERNEL_HEADERS_3_9=y
BR2_TOOLCHAIN_BUILDROOT_LARGEFILE=y
BR2_TOOLCHAIN_BUILDROOT_INET_IPV6=y
BR2_TOOLCHAIN_BUILDROOT_INET_RPC=y
BR2_TOOLCHAIN_BUILDROOT_LOCALE=y
BR2_PTHREAD_DEBUG=y
BR2_ENABLE_LOCALE_PURGE=y
BR2_ENABLE_LOCALE_WHITELIST="C"
BR2_TOOLCHAIN_BUILDROOT_CXX=y
BR2_TOOLCHAIN_BUILDROOT_USE_SSP=y
BR2_INIT_NONE=y
BR2_ROOTFS_POST_BUILD_SCRIPT="board/toolchain/package.sh"
# BR2_PACKAGE_BUSYBOX is not set
# BR2_TARGET_ROOTFS_TAR is not set
```

## configs/toolchain_defconfig
```kconfig
BR2_x86_i686=y
BR2_LINUX_KERNEL_CUSTOM_VERSION=y
BR2_LINUX_KERNEL_CUSTOM_VERSION_VALUE="3.9.11"
BR2_DEFCONFIG="$(CONFIG_DIR)/defconfig"
BR2_HOST_DIR="/opt/uclibc-toolchain"
BR2_ROOTFS_POST_BUILD_SCRIPT="board/toolchain/package.sh"
# BR2_TARGET_ROOTFS_TAR is not set
```

## configs/vagrant_defconfig
```kconfig
BR2_x86_i686=y
BR2_DEFCONFIG="$(CONFIG_DIR)/defconfig"
BR2_TOOLCHAIN_EXTERNAL=y
BR2_TOOLCHAIN_EXTERNAL_CUSTOM=y
BR2_TOOLCHAIN_EXTERNAL_PATH="/usr/local/uclibc-toolchain-3.9/usr"
BR2_TOOLCHAIN_EXTERNAL_CUSTOM_PREFIX="i686-buildroot-linux-uclibc"
BR2_TOOLCHAIN_EXTERNAL_LARGEFILE=y
BR2_TOOLCHAIN_EXTERNAL_INET_IPV6=y
BR2_TOOLCHAIN_EXTERNAL_LOCALE=y
BR2_TOOLCHAIN_EXTERNAL_INET_RPC=y
BR2_TOOLCHAIN_EXTERNAL_CXX=y
BR2_ENABLE_LOCALE_PURGE=y
BR2_ENABLE_LOCALE_WHITELIST="C"
BR2_ROOTFS_DEVICE_TABLE="board/vagrant/device_table.txt"
BR2_ROOTFS_SKELETON_CUSTOM=y
BR2_ROOTFS_SKELETON_CUSTOM_PATH="board/vagrant/skeleton"
BR2_ROOTFS_POST_BUILD_SCRIPT="board/vagrant/root_fs_pre.sh"
BR2_PACKAGE_BUSYBOX_CONFIG="board/vagrant/busybox.config"
BR2_PACKAGE_DROPBEAR=y
BR2_TARGET_ROOTFS_CPIO=y
BR2_TARGET_ROOTFS_CPIO_GZIP=y
# BR2_TARGET_ROOTFS_TAR is not set
```
